#include <string.h>

#include "freertos/FreeRTOS.h"
#include "freertos/semphr.h"
#include "driver/spi_master.h"
#include "esp_check.h"
#include "esp_lcd_io_spi.h"
#include "esp_lcd_panel_io.h"
#include "esp_lcd_panel_ops.h"
#include "esp_lcd_panel_vendor.h"
#include "esp_log.h"
#include "sdkconfig.h"

#include "board.h"
#include "display.h"

static const char *TAG = "display";

#define LCD_HOST        SPI2_HOST
#define LCD_SPI_HZ      (10 * 1000 * 1000)
#define FB_SIZE         (BOARD_LCD_WIDTH * BOARD_LCD_HEIGHT / 8)


// Este es su framebuffer basicamente a lo que le escriben para que 
// el display despues lo dibuje.
static uint8_t s_fb[FB_SIZE];
static esp_lcd_panel_handle_t s_panel;
static SemaphoreHandle_t s_flush_done;

// ROBADO ni loco escribia esto
static const uint8_t s_font[][5] = {
    {0x00, 0x00, 0x00, 0x00, 0x00}, /* ' ' */
    {0x00, 0x00, 0x5F, 0x00, 0x00}, /* ! */
    {0x00, 0x07, 0x00, 0x07, 0x00}, /* " */
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    {0x02, 0x01, 0x02, 0x04, 0x02}, /* ~ */
};

static bool on_color_trans_done(esp_lcd_panel_io_handle_t io, esp_lcd_panel_io_event_data_t *edata, void *user_ctx)
{
    BaseType_t woken = pdFALSE;
    xSemaphoreGiveFromISR(s_flush_done, &woken);
    return woken == pdTRUE;
}

esp_err_t display_init(void)
{
    s_flush_done = xSemaphoreCreateBinary();
    ESP_RETURN_ON_FALSE(s_flush_done, ESP_ERR_NO_MEM, TAG, "no mem for semaphore");

    const spi_bus_config_t bus_cfg = {
        .sclk_io_num = BOARD_LCD_SCL_IO,
        .mosi_io_num = BOARD_LCD_SDA_IO,
        .miso_io_num = -1,
        .quadwp_io_num = -1,
        .quadhd_io_num = -1,
        .max_transfer_sz = FB_SIZE,
    };
    ESP_RETURN_ON_ERROR(spi_bus_initialize(LCD_HOST, &bus_cfg, SPI_DMA_CH_AUTO), TAG, "spi bus init failed");

    esp_lcd_panel_io_handle_t io = NULL;
    const esp_lcd_panel_io_spi_config_t io_cfg = {
        .cs_gpio_num = BOARD_LCD_CS_IO,
        .dc_gpio_num = BOARD_LCD_DC_IO,
        .spi_mode = 0,
        .pclk_hz = LCD_SPI_HZ,
        .trans_queue_depth = 4,
        .lcd_cmd_bits = 8,
        .lcd_param_bits = 8,
        .on_color_trans_done = on_color_trans_done,
        .flags.dc_low_on_param = 1,
    };
    ESP_RETURN_ON_ERROR(esp_lcd_new_panel_io_spi((esp_lcd_spi_bus_handle_t)LCD_HOST, &io_cfg, &io), TAG,
                        "panel io init failed");

    const esp_lcd_panel_ssd1306_config_t ssd1306_cfg = {
        .height = BOARD_LCD_HEIGHT,
    };
    const esp_lcd_panel_dev_config_t panel_cfg = {
        .reset_gpio_num = BOARD_LCD_RST_IO,
        .bits_per_pixel = 1,
        .vendor_config = (void *)&ssd1306_cfg,
    };
    ESP_RETURN_ON_ERROR(esp_lcd_new_panel_ssd1306(io, &panel_cfg, &s_panel), TAG, "panel create failed");

    ESP_RETURN_ON_ERROR(esp_lcd_panel_reset(s_panel), TAG, "panel reset failed");
    ESP_RETURN_ON_ERROR(esp_lcd_panel_init(s_panel), TAG, "panel init failed");
#if CONFIG_HACK_DISPLAY_ROTATE_180
    ESP_RETURN_ON_ERROR(esp_lcd_panel_mirror(s_panel, true, true), TAG, "panel mirror failed");
#endif

    display_clear();
    ESP_RETURN_ON_ERROR(display_flush(), TAG, "first flush failed");
    ESP_RETURN_ON_ERROR(esp_lcd_panel_disp_on_off(s_panel, true), TAG, "display on failed");

    ESP_LOGI(TAG, "SSD1306 %dx%d ready", BOARD_LCD_WIDTH, BOARD_LCD_HEIGHT);
    return ESP_OK;
}

void display_clear(void)
{
    memset(s_fb, 0, sizeof(s_fb));
}

// Ejemplos varios de como dibujar cosas.

void display_set_pixel(int x, int y, bool on)
{
    if (x < 0 || x >= BOARD_LCD_WIDTH || y < 0 || y >= BOARD_LCD_HEIGHT) {
        return;
    }
    uint8_t *p = &s_fb[x + (y / 8) * BOARD_LCD_WIDTH];
    if (on) {
        *p |= (1u << (y % 8));
    } else {
        *p &= ~(1u << (y % 8));
    }
}

void display_fill_rect(int x, int y, int w, int h, bool on)
{
    for (int j = 0; j < h; j++) {
        for (int i = 0; i < w; i++) {
            display_set_pixel(x + i, y + j, on);
        }
    }
}

void display_draw_rect(int x, int y, int w, int h)
{
    for (int i = 0; i < w; i++) {
        display_set_pixel(x + i, y, true);
        display_set_pixel(x + i, y + h - 1, true);
    }
    for (int j = 0; j < h; j++) {
        display_set_pixel(x, y + j, true);
        display_set_pixel(x + w - 1, y + j, true);
    }
}

static void draw_char(int x, int y, char c, bool on)
{
    if (c < 32 || c > 126) {
        c = '?';
    }
    const uint8_t *glyph = s_font[c - 32];
    for (int col = 0; col < 5; col++) {
        for (int row = 0; row < 8; row++) {
            if (glyph[col] & (1u << row)) {
                display_set_pixel(x + col, y + row, on);
            }
        }
    }
}

void display_text(int x, int y, const char *str, bool invert)
{
    int len = strlen(str);

    if (invert) {
        display_fill_rect(x - 1, y - 1, len * DISPLAY_FONT_W + 1, DISPLAY_FONT_H + 2, true);
    } else {
        display_fill_rect(x, y, len * DISPLAY_FONT_W, DISPLAY_FONT_H, false);
    }
    for (int i = 0; i < len; i++) {
        draw_char(x + i * DISPLAY_FONT_W, y, str[i], !invert);
    }
}

esp_err_t display_flush(void)
{
    ESP_RETURN_ON_ERROR(esp_lcd_panel_draw_bitmap(s_panel, 0, 0, BOARD_LCD_WIDTH, BOARD_LCD_HEIGHT, s_fb), TAG,
                        "draw bitmap failed");
    ESP_RETURN_ON_FALSE(xSemaphoreTake(s_flush_done, pdMS_TO_TICKS(200)) == pdTRUE, ESP_ERR_TIMEOUT, TAG,
                        "flush timeout");
    return ESP_OK;
}
